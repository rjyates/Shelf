## distro/configs/oseink_x86_64_defconfig
```kconfig
BR2_x86_64=y
BR2_PACKAGE_HOST_LINUX_HEADERS_CUSTOM_6_12=y
BR2_SYSTEM_DHCP="eth0"
BR2_TARGET_GENERIC_HOSTNAME="oseink"
BR2_TARGET_GENERIC_ISSUE="Welcome to oseink"
BR2_TARGET_GENERIC_GETTY_PORT="tty0"
BR2_ROOTFS_OVERLAY="$(BR2_EXTERNAL_OSEINK_PATH)/overlay"
BR2_ROOTFS_POST_BUILD_SCRIPT="$(BR2_EXTERNAL_OSEINK_PATH)/board/oseink/x86_64/post-build.sh"
BR2_LINUX_KERNEL=y
BR2_LINUX_KERNEL_CUSTOM_VERSION=y
BR2_LINUX_KERNEL_CUSTOM_VERSION_VALUE="6.12.27"
BR2_LINUX_KERNEL_USE_CUSTOM_CONFIG=y
BR2_LINUX_KERNEL_CUSTOM_CONFIG_FILE="$(BR2_EXTERNAL_OSEINK_PATH)/board/oseink/x86_64/linux.config"
BR2_LINUX_KERNEL_NEEDS_HOST_LIBELF=y
BR2_ROOTFS_DEVICE_CREATION_DYNAMIC_EUDEV=y
BR2_PACKAGE_SEATD=y
BR2_PACKAGE_SEATD_DAEMON=y
BR2_PACKAGE_LIBINPUT=y
BR2_PACKAGE_WESTON=y
BR2_PACKAGE_WESTON_DEFAULT_HEADLESS=y
BR2_PACKAGE_WESTON_HEADLESS=y
BR2_PACKAGE_WESTON_SHELL_DESKTOP=y
# BR2_PACKAGE_WESTON_SHELL_FULLSCREEN is not set
# BR2_PACKAGE_WESTON_SHELL_IVI is not set
# BR2_PACKAGE_WESTON_SHELL_KIOSK is not set
# BR2_PACKAGE_WESTON_SCREENSHARE is not set
BR2_TARGET_ROOTFS_EXT2=y
BR2_TARGET_ROOTFS_EXT2_SIZE="128M"
# BR2_TARGET_ROOTFS_TAR is not set
```
